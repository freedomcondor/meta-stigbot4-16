## conf/bblayers.conf
```bitbake
# POKY_BBLAYERS_CONF_VERSION is increased each time build/conf/bblayers.conf
# changes incompatibly
POKY_BBLAYERS_CONF_VERSION = "2"

BBPATH = "${TOPDIR}"
BBFILES ?= ""

ROOTDIR = "${@os.path.abspath(os.path.join("${TOPDIR}", os.pardir))}"

BBLAYERS ?= " \
  ${ROOTDIR}/meta \
  ${ROOTDIR}/meta-poky \
  ${ROOTDIR}/meta-openembedded/meta-oe \
  ${ROOTDIR}/meta-openembedded/meta-networking \
  ${ROOTDIR}/meta-openembedded/meta-python \
  ${ROOTDIR}/meta-stigbot \
  "
```

## conf/layer.conf
```bitbake
# We have a conf and classes directory, append to BBPATH
BBPATH .= ":${LAYERDIR}"

# We have a recipes directory, add to BBFILES
BBFILES += "${LAYERDIR}/recipes*/*/*.bb ${LAYERDIR}/recipes*/*/*.bbappend ${LAYERDIR}/images/*.bb"

#BBFILE_COLLECTIONS += "meta-duovero"
#BBFILE_PATTERN_meta-duovero := "^${LAYERDIR}/"
#BBFILE_PRIORITY_meta-duovero = "16"

BBFILE_COLLECTIONS += "meta-stigbot"
BBFILE_PATTERN_meta-stigbot := "^${LAYERDIR}/"
BBFILE_PRIORITY_meta-stigbot = "16"
```
